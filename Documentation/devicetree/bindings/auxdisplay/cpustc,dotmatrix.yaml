## Documentation/devicetree/bindings/auxdisplay/cpustc,dotmatrix.yaml
```yaml
# SPDX-License-Identifier: (GPL-2.0-only OR BSD-2-Clause)
%YAML 1.2
---
$id: http://devicetree.org/schemas/auxdisplay/cpustc,dotmatrix.yaml#
$schema: http://devicetree.org/meta-schemas/core.yaml#

title: CPUSTC 8x8 LED dot matrix controller

maintainers:
  - CPUSTC maintainers <cpustcpu@users.noreply.github.com>

description: |
  The CPUSTC dot matrix controller stores a 64-bit pattern and scans eight
  rows in hardware. Pattern bit row * 8 + column selects one LED. The board
  wiring uses active-high rows and active-low columns.

properties:
  compatible:
    const: cpustc,dotmatrix

  reg:
    maxItems: 1

  cpustc,scan-divider:
    description: Number of controller clock cycles for each displayed row.
    $ref: /schemas/types.yaml#/definitions/uint32
    minimum: 1
    default: 33000

  cpustc,default-brightness:
    description: Initial 8-bit PWM brightness.
    $ref: /schemas/types.yaml#/definitions/uint32
    minimum: 0
    maximum: 255
    default: 255

required:
  - compatible
  - reg

additionalProperties: false

examples:
  - |
    soc {
        #address-cells = <1>;
        #size-cells = <1>;

        dotmatrix@1fe04300 {
            compatible = "cpustc,dotmatrix";
            reg = <0x1fe04300 0x14>;
            cpustc,scan-divider = <33000>;
            cpustc,default-brightness = <255>;
        };
    };

...
```

## Documentation/devicetree/bindings/display/cpustc,nt35510-lcd.txt
```
CPUSTC NT35510 LCD controller

The device combines the CPUSTC 16-bit 8080 LCD controller and its DMA reader
with a fixed 480x800 NT35510 panel. The controller has no read path, so the
compatible string selects the panel initialization data without probing an ID.

Required properties:
- compatible: must be "cpustc,nt35510-lcd"
- reg: base address and size of the controller register window
- interrupt-parent: phandle of the CPUSTC APB interrupt controller
- interrupts: APB interrupt-controller input used by LCD controller events

Optional properties:
- interrupt-names: may contain "event"

Example:

	lcd-controller@1fe70000 {
		compatible = "cpustc,nt35510-lcd";
		reg = <0x1fe70000 0x30>;
		interrupt-parent = <&cascade_intc>;
		interrupts = <1>;
		interrupt-names = "event";
	};
```

## Documentation/devicetree/bindings/display/cpustc,vga.yaml
```yaml
# SPDX-License-Identifier: (GPL-2.0-only OR BSD-2-Clause)
%YAML 1.2
---
$id: http://devicetree.org/schemas/display/cpustc,vga.yaml#
$schema: http://devicetree.org/meta-schemas/core.yaml#

title: CPUSTC VGA Display Controller

maintainers:
  - CPUSTC maintainers <cpustcpu@users.noreply.github.com>

description: |
  The CPUSTC VGA controller scans RGB565 pixels from system memory through an
  AXI read master. It provides a fixed 25 MHz VGA pixel clock, programmable
  640x480 timing registers, a framebuffer base register and a vblank interrupt.

properties:
  compatible:
    const: cpustc,vga

  reg:
    maxItems: 1

  interrupts:
    maxItems: 1

  interrupt-names:
    const: vblank

required:
  - compatible
  - reg
  - interrupts
  - interrupt-names

additionalProperties: false

examples:
  - |
    display-controller@1fe08000 {
        compatible = "cpustc,vga";
        reg = <0x1fe08000 0x34>;
        interrupt-parent = <&intc>;
        interrupts = <2>;
        interrupt-names = "vblank";
    };

...
```

## Documentation/devicetree/bindings/input/cpustc,confreg-keypad.yaml
```yaml
# SPDX-License-Identifier: (GPL-2.0-only OR BSD-2-Clause)
%YAML 1.2
---
$id: http://devicetree.org/schemas/input/cpustc,confreg-keypad.yaml#
$schema: http://devicetree.org/meta-schemas/core.yaml#

title: CPUSTC confreg 4x4 keypad

maintainers:
  - CPUSTC maintainers <cpustcpu@users.noreply.github.com>

description: |
  The CPUSTC confreg block scans and debounces a 4x4 matrix keypad in
  hardware. A 16-bit one-hot value reports the active key, with bit
  row * 4 + column corresponding to each matrix position.

allOf:
  - $ref: matrix-keymap.yaml#

properties:
  compatible:
    const: cpustc,confreg-keypad

  reg:
    maxItems: 1

  poll-interval:
    description: Poll interval in milliseconds.
    $ref: /schemas/types.yaml#/definitions/uint32
    minimum: 1
    default: 10

  keypad,num-rows:
    const: 4

  keypad,num-columns:
    const: 4

required:
  - compatible
  - reg
  - linux,keymap
  - keypad,num-rows
  - keypad,num-columns

unevaluatedProperties: false

examples:
  - |
    soc {
        #address-cells = <1>;
        #size-cells = <1>;

        keypad@1fd0f024 {
            compatible = "cpustc,confreg-keypad";
            reg = <0x1fd0f024 0x4>;
            poll-interval = <10>;
            keypad,num-rows = <4>;
            keypad,num-columns = <4>;
            linux,keymap = <0x0201001c  /* bit 9: KEY_ENTER */
                            0x02020067  /* bit 10: KEY_UP */
                            0x02030039  /* bit 11: KEY_SPACE */
                            0x03010069  /* bit 13: KEY_LEFT */
                            0x0302006c  /* bit 14: KEY_DOWN */
                            0x0303006a>; /* bit 15: KEY_RIGHT */
        };
    };

...
```

## Documentation/devicetree/bindings/interrupt-controller/cpustc,apb-interrupt-controller.txt
```
CPUSTC APB interrupt controller

The controller latches eight active-high interrupt inputs and combines the
enabled pending bits onto one parent interrupt. Pending bits are cleared by
writing one to the corresponding bit.

Required properties:
- compatible: must be "cpustc,apb-interrupt-controller"
- reg: base address and size of the register window
- interrupt-parent: phandle of the parent interrupt controller
- interrupts: interrupt specifier for the single parent interrupt
- interrupt-controller: identifies the node as an interrupt controller
- #interrupt-cells: must be 1; the cell is the input number from 0 to 7

Optional properties:
- interrupt-names: may contain "cascade"

Example:

	interrupt-controller@1fe74000 {
		compatible = "cpustc,apb-interrupt-controller";
		reg = <0x1fe74000 0x8>;
		interrupt-parent = <&cpuic>;
		interrupts = <9>;
		interrupt-names = "cascade";
		interrupt-controller;
		#interrupt-cells = <1>;
	};
```

## Documentation/devicetree/bindings/misc/cpustc,tensorcore.yaml
```yaml
# SPDX-License-Identifier: (GPL-2.0-only OR BSD-2-Clause)
%YAML 1.2
---
$id: http://devicetree.org/schemas/misc/cpustc,tensorcore.yaml#
$schema: http://devicetree.org/meta-schemas/core.yaml#

title: CPUSTC TensorCore accelerator

maintainers:
  - CPUSTC maintainers <cpustcpu@users.noreply.github.com>

description: |
  The CPUSTC TensorCore is a variable-size FP32 GEMM accelerator with an APB
  control interface, local A and B block-RAM buffers, an NHWC window loader,
  optional PReLU and pooling, and a non-coherent 32-bit AXI DMA master. One
  completion interrupt covers the full operation.

properties:
  compatible:
    const: cpustc,tensorcore

  reg:
    maxItems: 1

  interrupts:
    maxItems: 1

  interrupt-names:
    const: completion

required:
  - compatible
  - reg
  - interrupts
  - interrupt-names

additionalProperties: false

examples:
  - |
    soc {
        #address-cells = <1>;
        #size-cells = <1>;

        tensor@1fe04200 {
            compatible = "cpustc,tensorcore";
            reg = <0x1fe04200 0xc0>;
            interrupts = <3>;
            interrupt-names = "completion";
        };
    };

...
```
